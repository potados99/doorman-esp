## sdkconfig.defaults
```kconfig
# Flash
CONFIG_ESPTOOLPY_FLASHSIZE_8MB=y

# Partition (커스텀 파티션 테이블)
CONFIG_PARTITION_TABLE_CUSTOM=y

# CPU
CONFIG_ESP_DEFAULT_CPU_FREQ_MHZ_240=y

# PSRAM
CONFIG_SPIRAM=y
CONFIG_SPIRAM_USE_MALLOC=y
CONFIG_SPIRAM_TRY_ALLOCATE_WIFI_LWIP=y

# Bluetooth Dual Mode (Classic + BLE)
CONFIG_BT_ENABLED=y
CONFIG_BT_CLASSIC_ENABLED=y
CONFIG_BT_BLE_ENABLED=y
CONFIG_BT_SPP_ENABLED=y
CONFIG_BT_GATTS_ENABLE=y
CONFIG_BT_BLE_RPA_SUPPORTED=y
CONFIG_BTDM_CTRL_MODE_BTDM=y
CONFIG_BTDM_CTRL_MODEM_SLEEP=n

# 코어 분리: BT → Core 0, WiFi → Core 1
CONFIG_BT_BLUEDROID_PINNED_TO_CORE_0=y
CONFIG_BTDM_CTRL_PINNED_TO_CORE_0=y
CONFIG_ESP_WIFI_TASK_PINNED_TO_CORE_1=y

# FreeRTOS
CONFIG_FREERTOS_HZ=1000

# 코어덤프 → Flash
CONFIG_ESP_COREDUMP_ENABLE_TO_FLASH=y

# 로그 타임스탬프 → 시스템 시간
CONFIG_LOG_TIMESTAMP_SOURCE_SYSTEM=y

# 스택 오버플로우 워치포인트
CONFIG_FREERTOS_WATCHPOINT_END_OF_STACK=y

# 스택 스매싱 보호
CONFIG_COMPILER_STACK_CHECK_MODE_STRONG=y

# HTTP Server WebSocket 지원
CONFIG_HTTPD_WS_SUPPORT=y

# ── PSRAM 적극 활용 ──
CONFIG_SPIRAM=y
CONFIG_SPIRAM_USE_MALLOC=y
# 1024B 이상 alloc은 PSRAM 우선 (이전: 4096). 작은 alloc까지 PSRAM으로 보내
# 내부 RAM 압박을 크게 줄입니다. PSRAM 접근 속도 페널티는 우리 제어 패널
# 워크로드(낮은 throughput)에서 무시 가능.
CONFIG_SPIRAM_MALLOC_ALWAYSINTERNAL=1024
# 내부 RAM 예약을 8KB로 축소 (이전: 16KB). DMA·ISR이 필요한 alloc은 여전히
# 내부에서 잡히고, 나머지 일반 heap에 8KB 추가로 풀립니다.
CONFIG_SPIRAM_MALLOC_RESERVE_INTERNAL=8192
CONFIG_SPIRAM_ALLOW_STACK_EXTERNAL_MEMORY=y
# EXT_RAM_BSS_ATTR로 정적 배열을 PSRAM에 둘 수 있게 합니다.
# 주의: PSRAM 스택과 다르게 BSS 데이터는 캐시-mediated 접근만 발생하므로
# DMA·ISR 없는 한 안전합니다.
CONFIG_SPIRAM_ALLOW_BSS_SEG_EXTERNAL_MEMORY=y
CONFIG_BT_ALLOCATION_FROM_SPIRAM_FIRST=y
# WiFi/lwIP 동적 할당을 PSRAM으로 우선 라우팅 (이미 활성화 가정).
CONFIG_SPIRAM_TRY_ALLOCATE_WIFI_LWIP=y

# ── WiFi RX 버퍼 다이어트 ──
# 제어 패널 트래픽은 매우 낮음. 기본값(static 16/dynamic 32/BA win 16)은 과대.
# 줄여서 내부 RAM ~10KB 회수.
CONFIG_ESP_WIFI_STATIC_RX_BUFFER_NUM=10
CONFIG_ESP_WIFI_DYNAMIC_RX_BUFFER_NUM=16
CONFIG_ESP_WIFI_RX_BA_WIN=8

# ── BT 메모리 절약 ──
CONFIG_BT_GATT_MAX_SR_ATTRIBUTES=30
CONFIG_BT_GATT_MAX_SR_PROFILES=3
CONFIG_BT_ACL_CONNECTIONS=2

# ── IRAM / Flash 다이어트 ──
# heap_caps_* 함수들을 IRAM에서 flash로 이동. ~2KB IRAM 회수.
# ISR 경로에서 heap 호출이 미세하게 느려지지만 실측 영향 미미.
CONFIG_HEAP_PLACE_FUNCTION_INTO_FLASH=y
# printf 등의 nano 포맷 사용 (float 지원 제거). ~3~5KB flash/IRAM 회수.
# 이 프로젝트는 %f 계열을 쓰지 않으므로 영향 없음.
CONFIG_LIBC_NEWLIB_NANO_FORMAT=y
# 주의: CONFIG_ESP_WIFI_IRAM_OPT / ESP_WIFI_RX_IRAM_OPT는 이미 꺼져있음
# (sdkconfig 실측 확인). BT_CTRL_CODE_IN_IRAM / LIBC_LOCKS_PLACE_IN_IRAM
# 은 ISR/BT 안정성 리스크로 건드리지 않음.

# ── mbedTLS (Slack notifier outbound HTTPS 지원) ──
# SSL I/O 버퍼(기본 32KB 상시 점유)를 handshake 시에만 할당·해제. idle
# 메모리 수십 KB 회수. Slack 호출이 드물기 때문에 매번 할당·해제 오버헤드
# 수락 가능.
CONFIG_MBEDTLS_DYNAMIC_BUFFER=y
# handshake 후 peer cert / config data heap 반환 (dynamic buffer와 함께)
CONFIG_MBEDTLS_DYNAMIC_FREE_PEER_CERT=y
CONFIG_MBEDTLS_DYNAMIC_FREE_CONFIG_DATA=y
# Slack 요청 body는 수백 바이트 → 2KB로 충분. 2KB 절감.
CONFIG_MBEDTLS_SSL_OUT_CONTENT_LEN=2048
# 인증서 번들: FULL(Mozilla 전체 ~130개, flash ~500KB) → CMN(~41개 상위 CA).
# hooks.slack.com은 DigiCert Global Root 서명이라 CMN으로 커버 가능.
# 이 프로젝트의 outbound TLS는 Slack notifier가 유일한 경로이며,
# OTA(http push)와 웹 UI(reverse proxy 종단)는 bundle과 무관.
CONFIG_MBEDTLS_CERTIFICATE_BUNDLE_DEFAULT_FULL=n
CONFIG_MBEDTLS_CERTIFICATE_BUNDLE_DEFAULT_CMN=y
```
